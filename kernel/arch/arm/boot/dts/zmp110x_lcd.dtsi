/*
 * ZMP110x SoC LCD node
 *
 * This program is free software; you can redistribute it and/or modify
 * it under the terms of the GNU General Public License as published by
 * the Free Software Foundation; either version 2 of the License, or
 * (at your option) any later version.
 *
 * This program is distributed in the hope that it will be useful,
 * but WITHOUT ANY WARRANTY; without even the implied warranty of
 * MERCHANTABILITY or FITNESS FOR A PARTICULAR PURPOSE.  See the
 * GNU General Public License for more details.
 */


&lcdc {
    lcd-alarm-empty = <128>;
    lcd-alarm-full = <510>;
    lcd-dma-mode = <1>;
    //lcd-dummy-seq = <0>; //for 8bit rgb panel set
    //lcd-rgb-seq-sel = <0>;
    //lcd-rgb-odd-seq = <0>;
    //lcd-rgb-even-seq = <0>;
    lcd-rgb-tpg-sel = <1>;
    lcd-vpage-en = <0>; //don't support vpage function in driver
    lcd-blank-sel = <0>;
    lcd-pos-blank-level = <0>;
    lcd-neg-blank-level = <0>;
    lcd-rgb-bg-color = <0x00000000>;
    lcd-vh-delay-en = <0>;
    lcd-vh-delay-cycle = <0>;
    lcd-v-unit = <0>;
    lcd-alert-line = <30>;
    status = "disable";

    jd9366: lcd-panel@0 { //for JD9366 MIPI panel setting
        panel-if = <1>; //0 for RGB, 1 for MIPI
        panel-rgb-seq = <1>; //0 for BGR, 1 for RGB
        panel-width = <800>;
        panel-height = <1280>;
        panel-pclk-div = <8>; //pixel clock = Peri_pll/(pclk_div+1)
        panel-dsi-num-lane = <3>; //0-3: 1lane-4lane
        //0-3: data0-data3, 4: clk
        panel-dsi-txd0 = <0>;
        panel-dsi-txd1 = <1>;
        panel-dsi-txd2 = <4>;
        panel-dsi-txd3 = <2>;
        panel-dsi-txd4 = <3>;
        panel-dsi-noncontinuous-clk = <0>; //0:continuous,1:noncontinuous
        panel-dsi-t-pre = <1>; //t-pre, >=1
        panel-dsi-t-post = <1>; //t-post=tlpx+t-prepare+t-zero+t-pre, >=1
        panel-dsi-tx-gap = <1>; //ths-exit
        panel-dsi-autoinsert-eotp = <0>; //0:not insert,1:auto-insert
        panel-dsi-htx-to-count = <0xFFFFFF>; //high speed TX timeout count
        panel-dsi-lrx-to-count = <0xFFFFFF>; //Low power RX timeout count
        panel-dsi-bta-to-count = <0xFFFFFF>; //Bus turn around timeout count
        panel-dsi-t-wakeup = <0xc8>; //DPHY T-wakeup time
        panel-dsi-pix-fifo-send-level = <512>; //buffer send level <= 512
        //0-2:16-bit config 1-3; 3-4:18-bit config 1-2; 5:24-bit
        panel-dsi-if-color-coding = <0x05>;
        //0:16-bit;1:18-bit;2:18-bit loosely packed;3:24-bit
        panel-dsi-pix-format = <0x03>;
        panel-dsi-vsync-pol = <0>; //0:active low; 1:active high
        panel-dsi-hsync-pol = <0>; //0:active low; 1:active high
        //0:Non-burst mode with sync pulses;
        //1:Noe-burst mode with sync events;
        //2:Burst mode; 3:reserved
        panel-dsi-video-mode = <2>;
        panel-dsi-hfp = <32>; //H front porch blanking packet payload size in bytes
        panel-dsi-hbp = <20>; //H back porch blanking packet payload size in bytes
        panel-dsi-hsa = <20>; //H sync width blanking packet payload size in bytes
        panel-dsi-mult-pkts-en = <0>; //0: single packet;1: two packets
        panel-dsi-vbp = <6>; //V back porch lines
        panel-dsi-vfp = <8>; //V front porch lines
        panel-dsi-vsa = <4>;
        //0:blanking packets send during BLLP;1:LP mode used for BLLP
        panel-dsi-bllp-mode = <1>;
        panel-dsi-use-null-pkt-bllp = <0>; //0:blanking packet; 1:Null packet
        panel-dsi-vc = <0x00>; //Virtual channel
        panel-dsi-cmd-type = <0x0>; //0:send in LP mode, 1:send in HS mode
        panel-dsi-clk = <407>;

        status = "disable";

        //add special config list here
        panel-init-list =  //delay, type, data, parameters, end symbol
                          < 0x00 0x15 0xE0 0x00 0xFFF
                            0x00 0x15 0xE1 0x93 0xFFF
                            0x00 0x15 0xE2 0x65 0xFFF
                            0x00 0x15 0xE3 0xF8 0xFFF
                            0x00 0x15 0x80 0x03 0xFFF
                            0x00 0x15 0xE0 0x01 0xFFF
                            0x00 0x15 0x00 0x00 0xFFF
                            0x00 0x15 0x01 0xA3 0xFFF
                            0x00 0x15 0x03 0x00 0xFFF
                            0x00 0x15 0x04 0xA8 0xFFF
                            0x00 0x15 0x0E 0x00 0xFFF
                            0x00 0x15 0x17 0x00 0xFFF
                            0x00 0x15 0x18 0xB1 0xFFF
                            0x00 0x15 0x19 0x01 0xFFF
                            0x00 0x15 0x1A 0x00 0xFFF
                            0x00 0x15 0x1B 0xB1 0xFFF
                            0x00 0x15 0x1C 0x01 0xFFF
                            0x00 0x15 0x1F 0x3E 0xFFF
                            0x00 0x15 0x20 0x2D 0xFFF
                            0x00 0x15 0x21 0x2D 0xFFF
                            0x00 0x15 0x22 0x7E 0xFFF
                            0x00 0x15 0x37 0x19 0xFFF
                            0x00 0x15 0x38 0x05 0xFFF
                            0x00 0x15 0x39 0x00 0xFFF
                            0x00 0x15 0x3A 0x01 0xFFF
                            0x00 0x15 0x3C 0x78 0xFFF
                            0x00 0x15 0x3D 0xFF 0xFFF
                            0x00 0x15 0x3E 0xFF 0xFFF
                            0x00 0x15 0x3F 0xFF 0xFFF
                            0x00 0x15 0x40 0x06 0xFFF
                            0x00 0x15 0x41 0xA0 0xFFF
                            0x00 0x15 0x43 0x08 0xFFF
                            0x00 0x15 0x44 0x09 0xFFF
                            0x00 0x15 0x45 0x28 0xFFF
                            0x00 0x15 0x55 0x0F 0xFFF
                            0x00 0x15 0x57 0x89 0xFFF
                            0x00 0x15 0x58 0x0A 0xFFF
                            0x00 0x15 0x59 0x0A 0xFFF
                            0x00 0x15 0x5A 0x28 0xFFF
                            0x00 0x15 0x5B 0x19 0xFFF
                            0x00 0x15 0x5D 0x7C 0xFFF
                            0x00 0x15 0x5E 0x66 0xFFF
                            0x00 0x15 0x5F 0x56 0xFFF
                            0x00 0x15 0x60 0x49 0xFFF
                            0x00 0x15 0x61 0x44 0xFFF
                            0x00 0x15 0x62 0x34 0xFFF
                            0x00 0x15 0x63 0x37 0xFFF
                            0x00 0x15 0x64 0x1F 0xFFF
                            0x00 0x15 0x65 0x36 0xFFF
                            0x00 0x15 0x66 0x33 0xFFF
                            0x00 0x15 0x67 0x32 0xFFF
                            0x00 0x15 0x68 0x4F 0xFFF
                            0x00 0x15 0x69 0x3D 0xFFF
                            0x00 0x15 0x6A 0x43 0xFFF
                            0x00 0x15 0x6B 0x35 0xFFF
                            0x00 0x15 0x6C 0x30 0xFFF
                            0x00 0x15 0x6D 0x24 0xFFF
                            0x00 0x15 0x6E 0x13 0xFFF
                            0x00 0x15 0x6F 0x00 0xFFF
                            0x00 0x15 0x70 0x7C 0xFFF
                            0x00 0x15 0x71 0x66 0xFFF
                            0x00 0x15 0x72 0x56 0xFFF
                            0x00 0x15 0x73 0x49 0xFFF
                            0x00 0x15 0x74 0x44 0xFFF
                            0x00 0x15 0x75 0x34 0xFFF
                            0x00 0x15 0x76 0x37 0xFFF
                            0x00 0x15 0x77 0x1F 0xFFF
                            0x00 0x15 0x78 0x36 0xFFF
                            0x00 0x15 0x79 0x33 0xFFF
                            0x00 0x15 0x7A 0x32 0xFFF
                            0x00 0x15 0x7B 0x4F 0xFFF
                            0x00 0x15 0x7C 0x3D 0xFFF
                            0x00 0x15 0x7D 0x43 0xFFF
                            0x00 0x15 0x7E 0x35 0xFFF
                            0x00 0x15 0x7F 0x30 0xFFF
                            0x00 0x15 0x80 0x24 0xFFF
                            0x00 0x15 0x81 0x13 0xFFF
                            0x00 0x15 0x82 0x00 0xFFF
                            0x00 0x15 0xE0 0x02 0xFFF
                            0x00 0x15 0x00 0x45 0xFFF
                            0x00 0x15 0x01 0x45 0xFFF
                            0x00 0x15 0x02 0x44 0xFFF
                            0x00 0x15 0x03 0x44 0xFFF
                            0x00 0x15 0x04 0x47 0xFFF
                            0x00 0x15 0x05 0x47 0xFFF
                            0x00 0x15 0x06 0x46 0xFFF
                            0x00 0x15 0x07 0x46 0xFFF
                            0x00 0x15 0x08 0x40 0xFFF
                            0x00 0x15 0x09 0x1F 0xFFF
                            0x00 0x15 0x0A 0x1F 0xFFF
                            0x00 0x15 0x0B 0x1F 0xFFF
                            0x00 0x15 0x0C 0x1F 0xFFF
                            0x00 0x15 0x0D 0x1F 0xFFF
                            0x00 0x15 0x0E 0x1F 0xFFF
                            0x00 0x15 0x0F 0x41 0xFFF
                            0x00 0x15 0x10 0x1F 0xFFF
                            0x00 0x15 0x11 0x1F 0xFFF
                            0x00 0x15 0x12 0x1F 0xFFF
                            0x00 0x15 0x13 0x1F 0xFFF
                            0x00 0x15 0x14 0x1F 0xFFF
                            0x00 0x15 0x15 0x1F 0xFFF
                            0x00 0x15 0x16 0x45 0xFFF
                            0x00 0x15 0x17 0x45 0xFFF
                            0x00 0x15 0x18 0x44 0xFFF
                            0x00 0x15 0x19 0x44 0xFFF
                            0x00 0x15 0x1A 0x47 0xFFF
                            0x00 0x15 0x1B 0x47 0xFFF
                            0x00 0x15 0x1C 0x46 0xFFF
                            0x00 0x15 0x1D 0x46 0xFFF
                            0x00 0x15 0x1E 0x40 0xFFF
                            0x00 0x15 0x1F 0x1F 0xFFF
                            0x00 0x15 0x20 0x1F 0xFFF
                            0x00 0x15 0x21 0x1F 0xFFF
                            0x00 0x15 0x22 0x1F 0xFFF
                            0x00 0x15 0x23 0x1F 0xFFF
                            0x00 0x15 0x24 0x1F 0xFFF
                            0x00 0x15 0x25 0x41 0xFFF
                            0x00 0x15 0x26 0x1F 0xFFF
                            0x00 0x15 0x27 0x1F 0xFFF
                            0x00 0x15 0x28 0x1F 0xFFF
                            0x00 0x15 0x29 0x1F 0xFFF
                            0x00 0x15 0x2A 0x1F 0xFFF
                            0x00 0x15 0x2B 0x1F 0xFFF
                            0x00 0x15 0x58 0x40 0xFFF
                            0x00 0x15 0x5B 0x10 0xFFF
                            0x00 0x15 0x5C 0x06 0xFFF
                            0x00 0x15 0x5D 0x20 0xFFF
                            0x00 0x15 0x5E 0x01 0xFFF
                            0x00 0x15 0x5F 0x02 0xFFF
                            0x00 0x15 0x63 0x62 0xFFF
                            0x00 0x15 0x64 0x62 0xFFF
                            0x00 0x15 0x67 0x32 0xFFF
                            0x00 0x15 0x68 0x08 0xFFF
                            0x00 0x15 0x69 0x62 0xFFF
                            0x00 0x15 0x6A 0x66 0xFFF
                            0x00 0x15 0x6B 0x08 0xFFF
                            0x00 0x15 0x6C 0x00 0xFFF
                            0x00 0x15 0x6D 0x04 0xFFF
                            0x00 0x15 0x6E 0x04 0xFFF
                            0x00 0x15 0x6F 0x88 0xFFF
                            0x00 0x15 0xE0 0x03 0xFFF
                            0x00 0x15 0x98 0x3F 0xFFF
                            0x00 0x15 0xE0 0x04 0xFFF
                            0x00 0x15 0x09 0x10 0xFFF
                            0x00 0x15 0x2B 0x2B 0xFFF
                            0x00 0x15 0x2D 0x03 0xFFF
                            0x00 0x15 0x2E 0x44 0xFFF
                            0x00 0x15 0xE0 0x00 0xFFF
                            0x00 0x15 0xE6 0x02 0xFFF
                            0x00 0x15 0xE7 0x06 0xFFF
                            0x78 0x05 0x11 0x00 0xFFF
                            0x05 0x05 0x29 0x00 0xFFF
                            >;
    };

    
    tm070rdh13: lcd-panel@1 { //for RGB panel setting
        panel-if = <0>;
        panel-rgb-seq = <1>; 
        panel-pclk-div = <19>; 
        panel-width = <800>;
        panel-thpw = <20>;
        panel-thb = <46>;
        panel-thf = <210>;
        panel-height = <480>;
        panel-tvpw = <3>;
        panel-tvb = <23>;
        panel-tvf = <22>;
        panel-pclk-pol = <0>; //0:pos, 1:neg
        panel-hsync-pol = <1>;
        panel-vsync-pol = <1>;
        panel-vogate-pol = <0>;
        panel-bus-width = <1>; 
        panel-sync-mode = <1>;
        status = "disable";
    };

    gh8555bl: lcd-panel@2 { //for GH8555BL MIPI panel setting
        panel-if = <1>; //0 for RGB, 1 for MIPI
        panel-rgb-seq = <1>; //0 for BGR, 1 for RGB
        panel-width = <800>;
        panel-height = <1280>;
        panel-pclk-div = <8>; //pixel clock = Peri_pll/(pclk_div+1)
        panel-dsi-num-lane = <3>; //0-3: 1lane-4lane
        //0-3: data0-data3, 4: clk
        panel-dsi-txd0 = <0>;
        panel-dsi-txd1 = <1>;
        panel-dsi-txd2 = <4>;
        panel-dsi-txd3 = <2>;
        panel-dsi-txd4 = <3>;
        panel-dsi-noncontinuous-clk = <0>; //0:continuous,1:noncontinuous
        panel-dsi-t-pre = <1>; //t-pre, >=1
        panel-dsi-t-post = <1>; //t-post=tlpx+t-prepare+t-zero+t-pre, >=1
        panel-dsi-tx-gap = <1>; //ths-exit
        panel-dsi-autoinsert-eotp = <0>; //0:not insert,1:auto-insert
        panel-dsi-htx-to-count = <0xFFFFFF>; //high speed TX timeout count
        panel-dsi-lrx-to-count = <0xFFFFFF>; //Low power RX timeout count
        panel-dsi-bta-to-count = <0xFFFFFF>; //Bus turn around timeout count
        panel-dsi-t-wakeup = <0xc8>; //DPHY T-wakeup time
        panel-dsi-pix-fifo-send-level = <512>; //buffer send level <= 512
        //0-2:16-bit config 1-3; 3-4:18-bit config 1-2; 5:24-bit
        panel-dsi-if-color-coding = <0x05>;
        //0:16-bit;1:18-bit;2:18-bit loosely packed;3:24-bit
        panel-dsi-pix-format = <0x03>;
        panel-dsi-vsync-pol = <0>; //0:active low; 1:active high
        panel-dsi-hsync-pol = <0>; //0:active low; 1:active high
        //0:Non-burst mode with sync pulses;
        //1:Noe-burst mode with sync events;
        //2:Burst mode; 3:reserved
        panel-dsi-video-mode = <2>;
        panel-dsi-hfp = <80>; //H front porch blanking packet payload size in bytes
        panel-dsi-hbp = <20>; //H back porch blanking packet payload size in bytes
        panel-dsi-hsa = <20>; //H sync width blanking packet payload size in bytes
        panel-dsi-mult-pkts-en = <0>; //0: single packet;1: two packets
        panel-dsi-vbp = <8>; //V back porch lines
        panel-dsi-vfp = <15>; //V front porch lines
        panel-dsi-vsa = <6>;
        //0:blanking packets send during BLLP;1:LP mode used for BLLP
        panel-dsi-bllp-mode = <1>;
        panel-dsi-use-null-pkt-bllp = <0>; //0:blanking packet; 1:Null packet
        panel-dsi-vc = <0x00>; //Virtual channel
        panel-dsi-cmd-type = <0x0>; //0:send in LP mode, 1:send in HS mode
        panel-dsi-clk = <407>;

        status = "disable";

        //add special config list here
        panel-init-list = < //delay, type, data, parameters, end symbol
                        0x00 0x15 0xee 0x50 0xFFF
                        0x00 0x39 0xea 0x85 0x55 0xFFF
                        0x00 0x15 0x30 0x00 0xFFF
                        0x00 0x15 0x31 0x00 0xFFF
                        0x00 0x39 0x90 0x50 0x15 0xFFF
                        0x00 0x15 0x24 0x20 0xFFF
                        0x00 0x15 0x56 0x83 0xFFF
                        0x00 0x15 0x79 0x00 0xFFF
                        0x00 0x15 0x7a 0x20 0xFFF
                        0x00 0x15 0x7d 0x08 0xFFF
                        0x00 0x15 0x95 0x74 0xFFF
                        0x00 0x15 0x97 0x09 0xFFF
                        0x00 0x15 0x99 0x00 0xFFF
                        0x00 0x15 0xee 0x60 0xFFF
                        0x00 0x15 0x30 0x01 0xFFF
                        0x00 0x15 0x27 0x22 0xFFF
                        0x00 0x15 0x3a 0xa4 0xFFF
                        0x00 0x15 0x3b 0x00 0xFFF
                        0x00 0x15 0x3c 0x1a 0xFFF
                        0x00 0x15 0x3d 0x11 0xFFF
                        0x00 0x15 0x3e 0x93 0xFFF
                        0x00 0x15 0x42 0x64 0xFFF
                        0x00 0x15 0x43 0x64 0xFFF
                        0x00 0x15 0x44 0x0b 0xFFF
                        0x00 0x15 0x46 0x4e 0xFFF
                        0x00 0x15 0x8b 0x90 0xFFF
                        0x00 0x15 0x8d 0x45 0xFFF
                        0x00 0x15 0x91 0x11 0xFFF
                        0x00 0x15 0x92 0x11 0xFFF
                        0x00 0x15 0x93 0x9f 0xFFF
                        0x00 0x15 0x9a 0x00 0xFFF
                        0x00 0x15 0x9c 0x80 0xFFF
                        0x00 0x39 0x47 0x0f 0x24 0x2c 0x39 0x36 0xFFF
                        0x00 0x39 0x5A 0x0f 0x24 0x2c 0x39 0x36 0xFFF
                        0x00 0x39 0x4C 0x4a 0x40 0x51 0x31 0x2f 0xFFF
                        0x00 0x39 0x5F 0x4a 0x40 0x51 0x31 0x2f 0xFFF
                        0x00 0x39 0x51 0x2d 0x10 0x25 0x1f 0x30 0xFFF
                        0x00 0x39 0x64 0x2d 0x10 0x25 0x1f 0x30 0xFFF
                        0x00 0x39 0x56 0x37 0x46 0x5b 0x7F 0xFFF
                        0x00 0x39 0x69 0x37 0x46 0x5b 0x7F 0xFFF
                        0x00 0x15 0xee 0x70 0xFFF
                        0x00 0x39 0x00 0x03 0x07 0x00 0x01 0xFFF
                        0x00 0x39 0x04 0x08 0x0c 0x55 0x01 0xFFF
                        0x00 0x39 0x0c 0x05 0x3d 0xFFF
                        0x00 0x39 0x10 0x05 0x08 0x00 0x01 0x05 0xFFF
                        0x00 0x39 0x15 0x00 0x15 0x0d 0x08 0x00 0xFFF
                        0x00 0x39 0x29 0x05 0x3d 0xFFF
                        0x00 0x39 0x60 0x3c 0x3c 0x07 0x05 0x17 0xFFF
                        0x00 0x39 0x65 0x15 0x13 0x11 0x01 0x03 0xFFF
                        0x00 0x39 0x6a 0x3c 0x3c 0x3c 0x3c 0x3c 0xFFF
                        0x00 0x39 0x6f 0x3c 0x3c 0x3c 0x3c 0x3c 0xFFF
                        0x00 0x39 0x74 0x3C 0x3c 0xFFF
                        0x00 0x39 0x80 0x3c 0x3c 0x06 0x04 0x16 0xFFF
                        0x00 0x39 0x85 0x14 0x12 0x10 0x00 0x02 0xFFF
                        0x00 0x39 0x8a 0x3c 0x3c 0x3c 0x3c 0x3c 0xFFF
                        0x00 0x39 0x8f 0x3c 0x3c 0x3c 0x3c 0x3c 0xFFF
                        0x00 0x39 0x94 0x3c 0x3c 0xFFF
                        0x00 0x39 0xea 0x00 0x00 0xFFF
                        0x00 0x15 0xee 0x00 0xFFF
                        0xc8 0x05 0x11 0x00 0xFFF
                        0xc8 0x05 0x29 0x00 0xFFF
                        >;
    };
};
