## kernel/arch/arm/mach-zmp110x/Kconfig
```kconfig
# linux/arch/arm/mach-zmp110x/Kconfig
#
# Licensed under GPLv2

# Machine support

config MACH_ZMP110X
	bool "ZLGMCU ZMP1107_EVB Platform support"
	depends on ARCH_ZMP
	help
	  Support for zmp110x
```

## kernel/drivers/net/ethernet/zmp/Kconfig
```kconfig
#
# ZMP device configuration
#

config NET_ZMP
	tristate "ZMP devices"
	default y
	depends on ARCH_ZMP
	---help---
	  If you have a ZMP network (Ethernet) card, say Y.
```

## kernel/drivers/pinctrl/zmp/Kconfig
```kconfig
#
# ZMP pinctrl drivers
#
config PINCTRL_ZMP110X
	bool "ZMP110x GPIO (with PINCONF) driver"
	depends on OF_GPIO && ARCH_ZMP
	select GPIOLIB_IRQCHIP
	select PINCONF
	select PINMUX
	help
	  The ZMP110x Chip GPIO driver.
```
